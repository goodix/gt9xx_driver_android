/* 
 * Goodix GT9xx touchscreen driver
 * 
 * Copyright  (C)  2010 - 2014 Goodix. Ltd.
 * 
 * This program is free software; you can redistribute it and/or modify
 * it under the terms of the GNU General Public License as published by
 * the Free Software Foundation; either version 2 of the License, or
 * (at your option) any later version.
 * 
 * This program is distributed in the hope that it will be a reference 
 * to you, when you are integrating the GOODiX's CTP IC into your system, 
 * but WITHOUT ANY WARRANTY; without even the implied warranty of 
 * MERCHANTABILITY or FITNESS FOR A PARTICULAR PURPOSE.  See the GNU 
 * General Public License for more details.
 * 
 */
&soc {
	i2c@f9927000 { /*Goodix BLSP1 QUP5 */
		goodix_ts@5d {
			compatible = "goodix,gt9xx";
			reg = <0x5d>;
			interrupt-parent = <&msmgpio>;
			interrupts = <17 0x2008>;
			vdd_ana-supply = <&pm8226_l19>;
			vcc_i2c-supply = <&pm8226_lvs1>;
			goodix,rst-gpio = <&msmgpio 16 0x00>;
			goodix,irq-gpio = <&msmgpio 17 0x00>;
			goodix,cfg-group0 = [
				42 D0 02 00 05 05 75 01 01 0F 24 
				0F 64 3C 03 05 00 00 00 02 00 00 
				00 16 19 1C 14 8C 0E 0E 24 00 31 
				0D 00 00 00 83 33 1D 00 41 00 00 
				00 00 00 08 0A 00 2B 1C 3C 94 D5 
				03 08 00 00 04 93 1E 00 82 23 00 
				74 29 00 69 2F 00 5F 37 00 5F 20 
				40 60 00 F0 40 30 55 50 27 00 00 
				00 00 00 00 00 00 00 00 00 00 00 
				00 00 00 00 00 00 00 14 19 00 00 
				50 50 02 04 06 08 0A 0C 0E 10 12 
				14 16 18 1A 1C 00 00 00 00 00 00 
				00 00 00 00 00 00 00 00 00 00 1D 
				1E 1F 20 21 22 24 26 28 29 2A 1C 
				18 16 14 13 12 10 0F 0C 0A 08 06 
				04 02 00 00 00 00 00 00 00 00 00 
				00 00 00 00 00 00 00 00 9C 01];
			goodix,cfg-group2 = [
				48 D0 02 00 05 05 75 01 01 0F 24 
				0F 64 3C 03 05 00 00 00 02 00 00 
				00 16 19 1C 14 8C 0E 0E 24 00 31 
				0D 00 00 00 83 33 1D 00 41 00 00 
				3C 0A 14 08 0A 00 2B 1C 3C 94 D5 
				03 08 00 00 04 93 1E 00 82 23 00 
				74 29 00 69 2F 00 5F 37 00 5F 20 
				40 60 00 F0 40 30 55 50 27 00 00 
				00 00 00 00 00 00 00 00 00 00 00 
				00 00 00 00 00 00 00 14 19 00 00 
				50 50 02 04 06 08 0A 0C 0E 10 12 
				14 16 18 1A 1C 00 00 00 00 00 00 
				00 00 00 00 00 00 00 00 00 00 1D 
				1E 1F 20 21 22 24 26 28 29 2A 1C 
				18 16 14 13 12 10 0F 0C 0A 08 06 
				04 02 00 00 00 00 00 00 00 00 00 
				00 00 00 00 00 00 00 00 3C 01];
		};
};
